## conf/layer.conf
```bitbake
# We have a conf and classes directory, add to BBPATH
BBPATH .= ":${LAYERDIR}"

# We have recipes-* directories, add to BBFILES
BBFILES += "${LAYERDIR}/recipes-*/*/*.bb ${LAYERDIR}/recipes-*/*/*.bbappend"

BBFILE_COLLECTIONS += "machinekit-client"
BBFILE_PATTERN_machinekit-client = "^${LAYERDIR}/"
BBFILE_PRIORITY_machinekit-client = "7"

# This should only be incremented on significant changes that will
# cause compatibility issues with other layers
LAYERVERSION_machinekit-client = "1"

LAYERDEPENDS_machinekit-client = "mb"

LAYERSERIES_COMPAT_machinekit-client = "rocko"
```
